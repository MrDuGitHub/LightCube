#include <IRremote.h>  // 使用IRRemote函数库
const int irReceiverPin = A4;  // 红外接收器的 OUTPUT 引脚接在 PIN2 接口 定义irReceiverPin变量为PIN2接口

IRrecv irrecv(irReceiverPin); // 设置irReceiverPin定义的端口为红外信号接收端口
decode_results results;    // 定义results变量为红外结果存放位置

#define CUBESIZE 4
#define PLANESIZE CUBESIZE*CUBESIZE
#define PLANETIME 3333
#define TIMECONST 20   

const unsigned char PROGMEM PatternTable[] = {
  B0001, B0000, B0000, B0000, B0001, B0000, B0000, B0000, B0000, B0000, B0000, B0000, B0000, B0000, B0000, B0000, 10,
  B0011, B0000, B0000, B0000, B0011, B0000, B0000, B0000, B0000, B0000, B0000, B0000, B0000, B0000, B0000, B0000, 10,
  B0011, B0010, B0000, B0000, B0011, B0010, B0000, B0000, B0000, B0000, B0000, B0000, B0000, B0000, B0000, B0000, 10,
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  B0000, B0000, B0000, B0000, B0000, B0000, B0000, B0000, B0000, B0000, B0000, B0000, B0000, B0000, B0000, B0000, 10,
  //
  B0000, B0000, B0000, B0000, B0000, B0000, B0000, B0000, B0000, B0000, B0000, B0000, B0000, B0000, B0000, B0000, 0
};

int LEDPin[] = {2, 3, 4, 5, 6, 7, 8, 9, 10, 11, 12, 13, 14, 15, 16, 17};
int PlanePin[] = {8, 9, 10, 11};

void setup()
{
  int pin;
  for (pin = 0; pin < PLANESIZE; pin++)
  {
    pinMode(LEDPin[pin], OUTPUT);
  }
  //set up plane pins as outputs (active LOW)
  for (pin = 0; pin < CUBESIZE; pin++)
  {
    pinMode(PlanePin[pin], OUTPUT);
  }
  Serial.begin(9600);
  irrecv.enableIRIn();   // 启动红外解码
}
void loop()
{
  //声明变量
  byte PatternBuf[PLANESIZE];//从PatternTable保存当前模式
  int PatternIdx;
  byte DisplayTime;//时间* 100 ms显示模式
  unsigned long EndTime;
  int plane;//loop counter for cube refresh
  int patbufidx;//从模式缓冲区字节索引
  int ledrow;//counts LEDs in refresh loop
  int ledcol;//// counts LEDs in refresh loop
  int ledpin;//// counts LEDs in refresh loop
  //初始化PatternIdx
  PatternIdx = 0;
  //loop over entrise in pattern table-while dispalytime>0
  do {
    if (irrecv.decode(&results))
    {
      switch (results.value)
      {
        case 16712445:
          Serial.write(0);
          break;
        case 16730805:
          Serial.write(1);
          break;
        case 16738445:
          Serial.write(2);
          break;
      }
      irrecv.resume();
    }
    //从PROGMEM读取模式并保存在数组中
    memcpy_P(PatternBuf, PatternTable + PatternIdx, PLANESIZE);
    PatternIdx += PLANESIZE;
    //// read DisplayTime from PROGMEM and increment index
    DisplayTime = pgm_read_byte_near(PatternTable + PatternIdx++);
    // compute EndTime from current time (ms) and DisplayTime
    EndTime = millis() + ((unsigned long)DisplayTime) * TIMECONST;
    //loop while DisplayTime>0 and current time < EndTime
    while (millis() < EndTime) {
      patbufidx = 0; //索引计数器重置为缓冲区的开始
      //loop over planes
      for (plane = 0; plane < CUBESIZE; plane++) {
        //turn previous plane off
        if (plane == 0) {
          Serial.write(PlanePin[CUBESIZE - 1] * 2);
          //digitalWrite(PlanePin[CUBESIZE - 1], HIGH);
        } else {
          Serial.write(PlanePin[plane - 1] * 2);
          // digitalWrite(PlanePin[plane - 1], HIGH);
        }
        //// load current plane pattern data into ports
        ledpin = 0;
        for (ledrow = 0; ledrow < CUBESIZE; ledrow++) {
          for (ledcol = 0; ledcol < CUBESIZE; ledcol++) {
            digitalWrite(LEDPin[ledpin++], PatternBuf[patbufidx] & (1 << ledcol));
          }
          patbufidx++;
        }
        // turn current plane on
        Serial.write(PlanePin[plane] * 2 + 1);
        //digitalWrite(PlanePin[plane], LOW);
        //delay
        delayMicroseconds(PLANETIME);
      }//for plane
    }//while endtime
  } while (DisplayTime > 0); //res patterns until time=0 which signals end
}
